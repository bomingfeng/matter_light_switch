## run_board/kconfig/Kconfig.projbuild
```kconfig
#
#    Copyright (c) 2021 Project CHIP Authors
#    All rights reserved.
#
#    Licensed under the Apache License, Version 2.0 (the "License");
#    you may not use this file except in compliance with the License.
#    You may obtain a copy of the License at
#
#        http://www.apache.org/licenses/LICENSE-2.0
#
#    Unless required by applicable law or agreed to in writing, software
#    distributed under the License is distributed on an "AS IS" BASIS,
#    WITHOUT WARRANTIES OR CONDITIONS OF ANY KIND, either express or implied.
#    See the License for the specific language governing permissions and
#    limitations under the License.
#
#    Description:
#      Configuration options CHIP ESP32 demo application.
#

menu "Demo"

    choice
      prompt "Rendezvous Mode"
      default RENDEZVOUS_MODE_WIFI
      help
          Specifies the Rendezvous mode of the peripheral.

      config RENDEZVOUS_MODE_WIFI
          bool "Wi-Fi"
      config RENDEZVOUS_MODE_BLE
          bool "BLE"
      config RENDEZVOUS_MODE_THREAD
          bool "Thread"
      config RENDEZVOUS_MODE_ETHERNET
          bool "Ethernet"
    endchoice

    config RENDEZVOUS_MODE
       int
       range 0 8
       default 1 if RENDEZVOUS_MODE_WIFI
       default 2 if RENDEZVOUS_MODE_BLE
       default 4 if RENDEZVOUS_MODE_THREAD
       default 8 if RENDEZVOUS_MODE_ETHERNET

    config LED_Lights_GPIO
	int "LED_Lights_GPIO"
	range 0 19
	default 18
	help
		?

    config Lights_GPIO
	int "Lights_GPIO"
	range 0 18
	default 3
	help
		?

    config detectIR_GPIO 
	int "detectIR_GPIO"
	range 0 20
	default 19
	help
		?
    
    config BUTTON_GPIO_PIN
	int "BUTTON_GPIO_PIN"
	range 0 20
	default 9
	help
		?

    config Battery_Level_GPIO_PIN
	int "Battery Level GPIO PIN"
	range 0 20
	default 1
	help
		?
		
    config STATION_SSID
        string "Station SSID"
        default "fengboming"
        help
            SSID (network name) for the example to connect to.

    config STATION_PASSPHRASE
        string "Station Passphrase"
        default "bomingfeng1"
        help
            WiFi password (WPA or WPA2) for the example to use.
            Can be left blank if the network has no security set.
            
    config AP_SSID
        string "AP SSID"
        default "Automatic_watering"
        help
            AP SSID (network name) for the ESP32 to act as a AP

    config AP_PASSPHARSE
        string "AP Passphrase"
        default "12345678"
        help
            AP password (WPA or WPA2) to use.
            Can be left blank if the network has no security set.

endmenu
```
